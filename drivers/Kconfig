## drivers/Kconfig
```kconfig
# Copyright (c) 2024 CATIE
# SPDX-License-Identifier: Apache-2.0

menu "Device Drivers"

rsource "mfd/Kconfig"
rsource "rtc/Kconfig"
rsource "counter/Kconfig"
rsource "clock/Kconfig"

endmenu
```

## drivers/clock/Kconfig
```kconfig
# Copyright (c) 2024 CATIE
# SPDX-License-Identifier: Apache-2.0

if CLOCK_CONTROL

rsource "microcrystal/Kconfig"

endif # CLOCK_CONTROL
```

## drivers/clock/microcrystal/rv8803/Kconfig
```kconfig
# RV_8803_C7 driver configuration

# Copyright (c) 2024 CATIE
# SPDX-License-Identifier: Apache-2.0

menuconfig CLOCK_RV8803
    bool "RV-8803 peripheral CLOCK"
    default y
    depends on DT_HAS_MICROCRYSTAL_RV8803_CLOCK_ENABLED
    select I2C
    help
      Enable driver for MICRO CRYSTAL RV-8803 smt real-time clock module on i2c-bus
```

## drivers/clock_control/microcrystal/rv8803/Kconfig
```kconfig
# RV_8803_C7 driver configuration

# Copyright (c) 2024 CATIE
# SPDX-License-Identifier: Apache-2.0

if RV8803
  config RV8803_CLK_ENABLE
    bool "Enable Clock Control Interface"
    default n
    depends on RV8803
    help
      Enable Clock Control Interface.
endif # RV8803
```

## drivers/counter/microcrystal/rv8803/Kconfig
```kconfig
# RV_8803_C7 driver configuration

# Copyright (c) 2024 CATIE
# SPDX-License-Identifier: Apache-2.0

menuconfig COUNTER_RV8803
    bool "RV-8803 peripheral COUNTER"
    default y
    depends on DT_HAS_MICROCRYSTAL_RV8803_COUNTER_ENABLED
    select I2C
    help
      Enable driver for MICRO CRYSTAL RV-8803 smt real-time clock module on i2c-bus
```

## drivers/mfd/Kconfig
```kconfig
# Copyright (c) 2024 CATIE
# SPDX-License-Identifier: Apache-2.0

if MFD

rsource "microcrystal/Kconfig"

endif # MFD
```

## drivers/mfd/microcrystal/rv8803/Kconfig
```kconfig
# RV_8803_C7 driver configuration

# Copyright (c) 2024 CATIE
# SPDX-License-Identifier: Apache-2.0

menuconfig MFD_RV8803
    bool "MFD RV-8803 Device"
    default y
    depends on DT_HAS_MICROCRYSTAL_RV8803_ENABLED
    select I2C
    help
      Enable driver for MICRO CRYSTAL RV-8803 smt real-time clock module on i2c-bus

if MFD_RV8803

config MFD_RV8803_DETECT_BATTERY_STATE
    bool "Enable RTC battery flags"
    default y
    depends on RTC_RV8803
    help
      Enable flags on battery state of charge

config MFD_RV8803_WORKQUEUE
    bool "Custom RV-8803 work queue"
    default y
    help
      Enable RV-8803 work queue handling interrupts for all instances

if MFD_RV8803_WORKQUEUE

config MFD_RV8803_WORKQUEUE_PRIORITY
    int "Stack size for the RV-8803 interrupt work queue"
    default MAIN_THREAD_PRIORITY
    help
      Priority level for the work queue handling interrupts and dispatching callbacks

config MFD_RV8803_WORKQUEUE_SIZE
    int "Priority for the RV-8803 interrupt work queue"
    default 512
    help
      Size of the stack used for the work queue handling interrupts and dispatching callbacks

endif

endif
```

## drivers/rtc/Kconfig
```kconfig
# Copyright (c) 2024 CATIE
# SPDX-License-Identifier: Apache-2.0

if RTC

rsource "rv8803c7/Kconfig"

endif # RTC
```

## drivers/rtc/microcrystal/rv8803/Kconfig
```kconfig
# RV_8803_C7 driver configuration

# Copyright (c) 2024 CATIE
# SPDX-License-Identifier: Apache-2.0

menuconfig RV8803
    bool "RTC RV-8803 peripheral"
    default y
    depends on DT_HAS_MICROCRYSTAL_RV8803_CATIE_ENABLED
    select I2C
    help
      Enable driver for MICRO CRYSTAL RV-8803 smt real-time clock module on i2c-bus

if RV8803
  config RV8803_DETECT_BATTERY_STATE
    bool "Enable RTC battery flags"
    default y
    depends on RV8803
    help
      Enable flags on battery state of charge

  config RV8803_RTC_ENABLE
    bool "Enable RTC Interface"
    default y
    depends on RV8803
    depends on DT_HAS_MICROCRYSTAL_RV8803_RTC_CATIE_ENABLED
    help
      Enable real-time clock interface.

  config RV8803_COUNTER_ENABLE
    bool "Enable COUNTER Interface"
    default y
    depends on RV8803
    depends on DT_HAS_MICROCRYSTAL_RV8803_CNT_CATIE_ENABLED
    help
      Enable counter interface.

  config RV8803_CLK_ENABLE
    bool "Enable Clock Control Interface"
    default y
    depends on RV8803
    depends on DT_HAS_MICROCRYSTAL_RV8803_CLK_CATIE_ENABLED
    help
      Enable Clock Control Interface.
endif # RV8803
```

## drivers/rtc/rv8803c7/Kconfig
```kconfig
# RV_8803_C7 driver configuration

# Copyright (c) 2024 CATIE
# SPDX-License-Identifier: Apache-2.0

menuconfig RTC_RV8803C7
    bool "RTC RV-8803-C7 peripheral"
    default y
    depends on DT_HAS_MICROCRYSTAL_RV_8803_C7_ENABLED
    select I2C
    help
      Enable driver for MICRO CRYSTAL RV-8803-C7 smt real-time clock module on i2c-bus
```

## drivers/rtc/rv_8803_c7/Kconfig
```kconfig
# RV_8803_C7 driver configuration

# Copyright (c) 2024 CATIE
# SPDX-License-Identifier: Apache-2.0

config RTC_RV_8803_C7
    bool "RTC RV_8803_C7 peripheral"
    default y
    depends on DT_HAS_MICROCRYSTAL_RV_8803_C7_ENABLED
    select I2C
    help
      Enable driver for MICRO CRYSTAL RV_8803_C7 smt real-time clock module on i2c-bus
```

## dts/bindings/clock/microcrystal,rv8803-clock.yaml
```yaml
# Copyright (c) 2024 CATIE
# SPDX-License-Identifier: Apache-2.0

description: Micro Crystal AG RV-8803 Clock controller.

compatible: "microcrystal,rv8803-clock"

include:
  - name: clock-controller.yaml

on-bus: rv8803
```

## dts/bindings/counter/microcrystal,rv8803-counter.yaml
```yaml
# Copyright (c) 2024 CATIE
# SPDX-License-Identifier: Apache-2.0

description: Micro Crystal AG RV-8803 Counter.

compatible: "microcrystal,rv8803-counter"

include:
  - name: base.yaml

on-bus: rv8803

properties:
# Zephyr do not support values < 1Hz
  frequency:
    type: string
    required: true
    description: Configures RV-8803 counter frequency (Hz).
    enum:
      - "4096"
      - "64"
      - "1"

  use-irq:
    type: boolean
    description: Specify the use of interruption for the child.
```

## dts/bindings/mfd/microcrystal,rv8803.yaml
```yaml
# Copyright (c) 2024 CATIE
# SPDX-License-Identifier: Apache-2.0

description: Micro Crystal AG RV-8803 I2C-bus RTC, MFD device.

compatible: "microcrystal,rv8803"

include:
  - name: i2c-device.yaml

on-bus: i2c

bus: rv8803

properties:
  irq-gpios:
    type: phandle-array
    description: Configures RV-8803 MFD interrupt signal.

child-binding:
  description: Drivers that uses RV8803.

  properties:
    use-irq:
      type: boolean
      description: Enable RV-8803 interrupt generation.
```

## dts/bindings/rtc/microcrystal,rv-8803-c7.yaml
```yaml
# Copyright (c) 2024 CATIE
# SPDX-License-Identifier: Apache-2.0

description: Micro Crystal AG RV_8803_C7 RTC.

compatible: "microcrystal,rv-8803-c7"

#on-bus: i2c

include:
  - name: rtc-device.yaml
  - name: i2c-device.yaml
```

## dts/bindings/rtc/microcrystal,rv-8803.yaml
```yaml
# Copyright (c) 2024 CATIE
# SPDX-License-Identifier: Apache-2.0

description: Micro Crystal AG RV-8803 RTC.

compatible: "microcrystal,rv-8803"

#on-bus: i2c

include:
  - name: rtc-device.yaml
  - name: i2c-device.yaml
```

## dts/bindings/rtc/microcrystal,rv8803-clk.yaml
```yaml
# Copyright (c) 2024 CATIE
# SPDX-License-Identifier: Apache-2.0

description: Micro Crystal AG RV-8803 CLK.

compatible: "microcrystal,rv8803-clk"

include:
  - name: clock-controller.yaml
```

## dts/bindings/rtc/microcrystal,rv8803-cnt.yaml
```yaml
# Copyright (c) 2024 CATIE
# SPDX-License-Identifier: Apache-2.0

description: Micro Crystal AG RV-8803 CNT.

compatible: "microcrystal,rv8803-cnt"

include:
  - name: base.yaml

properties:
  frequency:
    type: string
    required: true
    description: Configures RV-8803 counter frequency (Hz).
    enum:
      - "4096"
      - "64"
      - "1"
      - "1/60"
```

## dts/bindings/rtc/microcrystal,rv8803-rtc-catie.yaml
```yaml
# Copyright (c) 2024 CATIE
# SPDX-License-Identifier: Apache-2.0

description: Micro Crystal AG RV-8803 RTC.

compatible: "microcrystal,rv8803-rtc-catie"

include:
  - name: rtc-device.yaml
```

## dts/bindings/rtc/microcrystal,rv8803-rtc.yaml
```yaml
# Copyright (c) 2024 CATIE
# SPDX-License-Identifier: Apache-2.0

description: Micro Crystal AG RV-8803 RTC.

compatible: "microcrystal,rv8803-rtc"

include:
  - name: rtc-device.yaml

on-bus: rv8803

properties:
  use-irq:
    type: boolean
    description: Configures RV-8803 RTC to use interruption.
  alarm:
    type: string
    enum:
      - "poll"
      - "irq"
    required: true
    description: Configures alarm of RV-8803 RTC to use interruption.
  update:
    type: string
    enum:
      - "poll"
      - "irq"
    required: true
    description: Configures update of RV-8803 RTC to use interruption.
```

## dts/bindings/rtc/microcrystal,rv8803.yaml
```yaml
# Copyright (c) 2024 CATIE
# SPDX-License-Identifier: Apache-2.0

description: Micro Crystal AG RV-8803.

compatible: "microcrystal,rv8803"

#on-bus: i2c

include:
  - name: i2c-device.yaml
```
